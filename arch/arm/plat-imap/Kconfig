## arch/arm/plat-imap/Kconfig
```kconfig
# arch/arm/plat-imap/Kconfig
#
# Copyright (c) 2009~2014 ShangHai Infotm Ltd all rights reserved.
#
# Licensed under GPLv2

config PLAT_IMAP
	bool
	depends on ARCH_IMAP
	default y if ARCH_IMAP
	select NO_IOPORT
	select ARCH_REQUIRE_GPIOLIB
	help
	  Base platform code for any Infotm IMAP device

if PLAT_IMAP

config PLAT_IMAPX200
	bool "IMAPX200 Platform support"
	depends on ARCH_IMAP
	default y if CPU_IMAPX200
	help
	  Support for Infotm IMAPX200 CPU based systems.

config IMAP_PRODUCTION
	bool "IMAPX200 Production support"
	default n if CPU_IMAPX200
	help
	  Support for IMAPX200 Production .

choice
depends on IMAP_PRODUCTION
prompt  "Select a supported platform"

config  IMAP_PRODUCTION_7901
        bool "Platform 7901"
config  IMAP_PRODUCTION_0702
        bool "Platform 0702"
config  IMAP_PRODUCTION_S01
        bool "Platform S01"
endchoice


config	FAKE_PM 
	bool "Support for fake power manage"
	depends on IMAP_PRODUCTION 
	default n


config IMAPX200_PWM
	bool "PWM device support"
	default y if CPU_IMAPX200
	select HAVE_PWM
	help
	  Support for exporting the PWM timer blocks via the pwm device
	  system.

config IMAPX200_DMA
	bool "IMAPX200 DMA support"
	depends on ARCH_IMAP
	help
	  IMAPX200 DMA support. This is needed for drivers like sound which
	  use the DMA system to move data to and from the peripheral blocks.

config IMAPX200_DMA_DEBUG
	bool "IMAPX200 DMA support debug"
	depends on ARCH_IMAP && IMAPX200_DMA
	help
	  Enable debugging output for the DMA code. This option sends info
	  to the kernel log, at priority KERN_DEBUG.

config IMAP_LOWLEVEL_UART_PORT
	int "IMAP UART to use for low-level messages"
	depends on PLAT_IMAP
	default 0
	help
	  Choice of which UART port to use for the low-level messages,
	  such as the `Uncompressing...` at start time. The value of
	  this configuration should be between zero and two. The port
	  must have been initialised by the boot-loader before use.



comment "iMAP Settings"

menu "iMAP Reserved Memory"

config IMAP_RESERVEMEM_SIZE_ETH
	int "Memory Size Reserved for Ethernet (KB)"
	depends on ARCH_IMAP && GMAC_UNIV_ETHERNET
	default "0"
config IMAP_RESERVEMEM_SIZE_PMEM
	int "Memory Size Reserved for Android_pmem (KB)"
	depends on ARCH_IMAP && ANDROID_PMEM
	default "0"

endmenu

config IMAP_FPGA
	bool "iMAP FPGA Clock"
	depends on ARCH_IMAP
	default n
	help
	  If you are operating on the FPGA platform, say Y here!

config FPGA_EXT_CLOCK
	int "FPGA External Clock Setting"
	depends on IMAP_FPGA
	default "40000000"

endif
```
